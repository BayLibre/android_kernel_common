## drivers/clk/zhihe/Kconfig
```kconfig
# SPDX-License-Identifier: GPL-2.0

config ZHIHE_CLK
	tristate

config CLK_A210
	tristate "Zhihe A210 clock driver"
	depends on ARCH_ZHIHE
	select ZHIHE_CLK
	help
	  Support for the clock controllers of the Zhihe A210 SoC.
```

## drivers/gpu/drm/amd/display/Kconfig
```kconfig
# SPDX-License-Identifier: GPL-2.0-only
menu "Display Engine Configuration"
	depends on DRM && DRM_AMDGPU

config DRM_AMD_DC
	bool "AMD DC - Enable new display engine"
	default y
	depends on BROKEN || !CC_IS_CLANG || X86_64 || SPARC64 || ARM64
	select SND_HDA_COMPONENT if SND_HDA_CORE
	select DRM_AMD_DC_DCN1_0 if X86 && !(KCOV_INSTRUMENT_ALL && KCOV_ENABLE_COMPARISONS)
	help
	  Choose this option if you want to use the new display engine
	  support for AMDGPU. This adds required support for Vega and
	  Raven ASICs.

	  calculate_bandwidth() is presently broken on all !(X86_64 || SPARC64 || ARM64)
	  architectures built with Clang (all released versions), whereby the stack
	  frame gets blown up to well over 5k.  This would cause an immediate kernel
	  panic on most architectures.  We'll revert this when the following bug report
	  has been resolved: https://github.com/llvm/llvm-project/issues/41896.

config DRM_AMD_DC_DCN1_0
	def_bool n
	help
	  RV family support for display engine

config DRM_AMD_DC_DCN2_0
	bool "DCN 2.0 family"
	default y
	depends on DRM_AMD_DC && X86
	depends on DRM_AMD_DC_DCN1_0
	help
	    Choose this option if you want to have
	    Navi support for display engine

config DRM_AMD_DC_DCN2_1
        bool "DCN 2.1 family"
        depends on DRM_AMD_DC && X86
        depends on DRM_AMD_DC_DCN2_0
        help
            Choose this option if you want to have
            Renoir support for display engine

config DRM_AMD_DC_DSC_SUPPORT
	bool "DSC support"
	default y
	depends on DRM_AMD_DC && X86
	depends on DRM_AMD_DC_DCN1_0
	depends on DRM_AMD_DC_DCN2_0
	help
	    Choose this option if you want to have
	    Dynamic Stream Compression support

config DEBUG_KERNEL_DC
	bool "Enable kgdb break in DC"
	depends on DRM_AMD_DC
	help
	  Choose this option
	  if you want to hit
	  kdgb_break in assert.

endmenu
```

## drivers/gpu/drm/spacemit_k3/Kconfig
```kconfig
# SPDX-License-Identifier: GPL-2.0

config DRM_SPACEMIT_K3
	tristate "DRM Support for Spacemit K3 (saturn-hee) display"
	depends on DRM && (ARCH_SPACEMIT || COMPILE_TEST)
	help
	  K3-generation (saturn-hee/saturn-edp) display support for Spacemit
	  SoCs.  This is a distinct hardware revision from the K1 'saturn'
	  generation handled by CONFIG_DRM_SPACEMIT; the two are not drop-in
	  compatible and are built as separate modules.  Enabling this option
	  only pulls in the K3-specific drivers selected below and does not
	  affect the K1 spacemit-drm driver.

config DRM_SPACEMIT_K3_DPU
	tristate "Spacemit K3 DPU master + CRTC (scan-out)"
	depends on DRM_SPACEMIT_K3
	depends on COMMON_CLK && RESET_CONTROLLER
	depends on I2C
	select DRM_KMS_HELPER
	select DRM_GEM_DMA_HELPER
	select DRM_GEM_CMA_HELPER
	select DRM_KMS_CMA_HELPER
	select DRM_MIPI_DSI
	select DRM_PANEL
	select DRM_CLIENT_SELECTION
	select DRM_FBDEV_EMULATION
	select VIDEOMODE_HELPERS
	select BACKLIGHT_CLASS_DEVICE
	help
	  K3-generation DPU master driver: registers the drm_device and the
	  CRTC/scan-out (binds spacemit,saturn-hee / saturn-edp for the master
	  and spacemit,dpu-saturn for the CRTC), and calls component_bind_all()
	  so the K3 DSI/DPHY/DP sub-drivers attach.  Built as spacemit-drm-k3.ko,
	  a separate module from the K1 spacemit-drm.ko; their of_match tables
	  are disjoint so the two coexist in the same tree.  Requires runtime PM,
	  the common clock framework and a reset controller.

config SPACEMIT_INNO_DP
	tristate "Spacemit K3 Innosilicon DP/eDP support"
	depends on DRM_SPACEMIT_K3
	select DRM_DISPLAY_HELPER
	select DRM_DISPLAY_DP_HELPER
	select DRM_DISPLAY_DP_AUX_BUS
	select DRM_KMS_HELPER
	help
	  Support for the Spacemit K3 SoC Innosilicon DisplayPort / embedded
	  DisplayPort controller.  Binds spacemit,inno-{dp,edp}{0,1}.  Builds
	  as a self-contained module (spacemit_inno_dp.ko) that joins the DRM
	  device through the component framework; it does not link against the
	  K1 spacemit-drm driver.
```

## drivers/launch_boost/Kconfig
```kconfig
# SPDX-License-Identifier: GPL-2.0-only
#
# launch boost driver configuration
#

menuconfig XRING_LB
	bool "APP launch boost support"
	help
	  Enable this option to activate APP launch boost support, which is designed
	  to enhance the performance of application launches by pre-reading necessary
	  files into memory. This feature can significantly reduce the time it takes
	  for applications to start.

	  When enabled, the system will monitor application launch requests and
	  pre-load the required files into memory, allowing for faster access and
	  reduced latency. This can be particularly beneficial for frequently used
	  applications or those with large resource files.
```

## drivers/phy/spacemit/Kconfig
```kconfig
# SPDX-License-Identifier: GPL-2.0-only
#
# Phy drivers for SpacemiT platforms
#
config PHY_SPACEMIT_K1_PCIE
	tristate "PCIe and combo PHY driver for the SpacemiT K1 SoC"
	depends on ARCH_SPACEMIT || COMPILE_TEST
	depends on COMMON_CLK
	depends on HAS_IOMEM
	depends on OF
	select GENERIC_PHY
	default ARCH_SPACEMIT
	help
	  Enable support for the PCIe and USB 3 combo PHY and two
	  PCIe-only PHYs used in the SpacemiT K1 SoC.

config PHY_SPACEMIT_K1_USB2
	tristate "SpacemiT K1 USB 2.0 PHY support"
	depends on (ARCH_SPACEMIT || COMPILE_TEST) && OF
	depends on COMMON_CLK
	depends on USB_COMMON
	select GENERIC_PHY
	help
	  Enable this to support K1 USB 2.0 PHY driver. This driver takes care of
	  enabling and clock setup and will be used by K1 udc/ehci/otg/xhci driver.

config PHY_SPACEMIT_K1X_COMBPHY
	tristate "Spacemit K1-x USB3&PCIE combo PHY driver"
	depends on OF
	select GENERIC_PHY
	default SOC_SPACEMIT_K1X && USB_DWC3_SPACEMIT
	help
	  USB3 and PCIE Combo PHY Support for Spacemit k1-x Soc

config PHY_SPACEMIT_K3_USB3
	tristate "SpacemiT K3 USB 3.0 PHY support"
	depends on (ARCH_SPACEMIT || COMPILE_TEST) && OF
	depends on COMMON_CLK
	depends on USB_COMMON
	depends on TYPEC || TYPEC=n
	select GENERIC_PHY
	help
	  Enable this to support K3 USB 3.0 PHY driver. This driver takes care of
	  enabling and clock setup and will be used by K3 dwc3 driver. It also
	  exposes the Type-C orientation switch built into the combo PHY.

config PHY_SPACEMIT_K3_PCIE
	tristate "SpacemiT K3 PCIe PHY support"
	depends on (ARCH_SPACEMIT || COMPILE_TEST) && OF
	depends on COMMON_CLK
	depends on HAS_IOMEM
	select GENERIC_PHY
	help
	  Enable this to support the K3 PCIe PHY driver.  It exposes the PCIe
	  PHY initialisation sequence (lane setup, PLL lock and RCAL trim) via
	  the generic PHY framework so the K3 PCIe controller can be wired up
	  through the standard DT "phys" binding.

config PHY_SPACEMIT_K3_INNO_DP
	tristate "SpacemiT K3 Innosilicon DisplayPort PHY driver"
	depends on (ARCH_SPACEMIT || COMPILE_TEST) && OF
	depends on COMMON_CLK
	select GENERIC_PHY
	select REGMAP
	help
	  Enable support for the Innosilicon DisplayPort transmit PHY
	  integrated in the SpacemiT K3 SoC. The PHY shares its MMIO window
	  with its parent DP/eDP controller (drivers/gpu/drm/spacemit/) and
	  exposes lane / rate / vswing / pre-emphasis control through the
	  generic PHY framework.
```

## drivers/phy/zhihe/Kconfig
```kconfig
# SPDX-License-Identifier: GPL-2.0-only

config PHY_ZHIHE_SNPS_USB2
	tristate "Zhihe A210 USB 2.0 PHY driver"
	depends on ARCH_ZHIHE
	depends on HAS_IOMEM
	select GENERIC_PHY
	select MFD_SYSCON
	help
	  Support for the Synopsys USB 2.0 PHYs of the Zhihe A210 SoC, used
	  by the two DWC2 host controllers and by the DWC3 controller.
```

## drivers/platform/Kconfig
```kconfig
# SPDX-License-Identifier: GPL-2.0-only
if X86
source "drivers/platform/x86/Kconfig"
endif
if MIPS
source "drivers/platform/mips/Kconfig"
endif

source "drivers/platform/goldfish/Kconfig"

source "drivers/platform/chrome/Kconfig"

source "drivers/platform/mellanox/Kconfig"

source "drivers/platform/olpc/Kconfig"

config MSM_GENI_SE
	tristate "QCOM GENI Serial Engine Driver"
	help
	  This module is used to interact with GENI based Serial Engines on
	  Qualcomm Technologies, Inc. Universal Peripheral(QUPv3). This
	  module is used to configure and read the configuration from the
	  Serial Engines.
```

## drivers/platform/msm/Kconfig
```kconfig
# SPDX-License-Identifier: GPL-2.0-only

menu "Qualcomm technologies inc. MSM specific device drivers"
	depends on ARCH_QCOM

config MSM_GENI_SE
	tristate "QCOM GENI Serial Engine Driver"
	help
	  This module is used to interact with GENI based Serial Engines on
	  Qualcomm Technologies, Inc. Universal Peripheral(QUPv3). This
	  module is used to configure and read the configuration from the
	  Serial Engines.

endmenu
```

## drivers/pmdomain/spacemit/Kconfig
```kconfig
# SPDX-License-Identifier: GPL-2.0-only
config SPACEMIT_PM_DOMAINS
	tristate "SpacemiT K1 Power Domain driver"
	depends on ARCH_SPACEMIT || COMPILE_TEST
	depends on PM
	select PM_GENERIC_DOMAINS
	help
	  Support for SpacemiT K1 SoC power domains. This driver manages
	  the power domains for peripherals such as HDMI, LCD, and USB.

config SPACEMIT_K3_PM_DOMAINS
	tristate "SpacemiT K3 Power Domain driver (RPMI)"
	depends on ARCH_SPACEMIT || COMPILE_TEST
	depends on PM
	depends on MAILBOX
	select PM_GENERIC_DOMAINS
	help
	  Support for SpacemiT K3 SoC power domains. The domains are
	  controlled by the power management firmware over the RISC-V
	  RPMI device-power service group via the SBI MPXY mailbox.
```

## drivers/pmdomain/zhihe/Kconfig
```kconfig
# SPDX-License-Identifier: GPL-2.0-only

config A210_POWER_DOMAIN
	tristate "Zhihe A210 power domain driver"
	depends on ARCH_ZHIHE && RISCV_SBI && PM
	select PM_GENERIC_DOMAINS
	help
	  Support for the power domains of the Zhihe A210 SoC.
```

## drivers/soc/spacemit/Kconfig
```kconfig
# SPDX-License-Identifier: GPL-2.0-only

config SPACEMIT_SOCINFO
	tristate "Spacemit SoC information driver"
	depends on ARCH_SPACEMIT || COMPILE_TEST
	depends on NVMEM_SPACEMIT_EFUSE
	select SOC_BUS
	help
	  Reads die_id, pack_id and chip serial from eFuse via nvmem and
	  registers the SoC device via soc_device_register(). Exposes chip
	  name (K1-6370, M1-8571, ...), silicon revision and serial number
	  under /sys/bus/soc/devices/.

	  This driver can also be built as a module. If so, the module
	  will be called spacemit-socinfo.

config SPACEMIT_K3_PMU_KEEPALIVE
	bool "SpacemiT K3 PMU idle-vote keep-alive"
	depends on ARCH_SPACEMIT || COMPILE_TEST
	help
	  Periodically clears the K3 AP core/cluster power-down votes from
	  Linux. The reset-armed votes collapse a bare-WFI hart below IMSIC
	  reach once the RCPU ESOS firmware re-arms them at runtime, hard
	  freezing the machine in an all-idle lull. Built in (not a module):
	  it must run before the first deep idle.

config SPACEMIT_K1X_DMA_RANGE
	tristate "Spacemit dram range driver for k1x"
	depends on ARCH_SPACEMIT || COMPILE_TEST
	help
	  This driver is an empty shell, in order to make the dma-ranges
	  function effective by registering the spacemit-dram-bus compatible
	  so that of_platform instantiates child dram_range nodes.

config SPACEMIT_DDR_BW
	tristate "Spacemit K1x DDR AXI monitor / bandwidth driver"
	depends on ARCH_SPACEMIT || COMPILE_TEST
	depends on PM_DEVFREQ
	help
	  Spacemit K1x DDR AXI monitor driver. Reads DDR bandwidth from the
	  DDR controller and uses devfreq to scale DDR frequency under load.
	  Exposes a character device for userspace monitoring.

config SPACEMIT_HMP
	bool "Spacemit HMP support"
	depends on SMP && ARCH_SPACEMIT
	help
	  Say y here to enable the HMP feature support.
	  This feature categorizes the CPU cores within the
	  SOC into two distinct types, each running different
	  types of threads.

config SPACEMIT_REBOOT_CONTROL
	bool "Spacemit k3 reboot handler"
	depends on ARCH_SPACEMIT
	help
	  Say y here to support go to uboot fastboot when reset.

config SPACEMIT_SUSPEND_AFFINITY
	bool "Spacemit k3 handle irq affinity when standby"
	depends on ARCH_SPACEMIT && PM_SLEEP
	help
	  Say y here to handle irq affinity in resume process to migrate
	  back to cpu before suspend.

config SPACEMIT_POWERKEY_MONITOR
	bool "Spacemit power key monitor config"
	depends on ARCH_SPACEMIT
	help
	  Say y here to using gpio to monitor the power key

source "drivers/soc/spacemit/v2d/Kconfig"
```

## drivers/trusty/Kconfig
```kconfig
# SPDX-License-Identifier: GPL-2.0-only
#
# Trusty driver
#

menu "Trusty driver"

config TRUSTY
	tristate "Trusty core driver"
	depends on ARM || ARM64
	help
	  Trusty is a secure OS that provides a Trusted Execution Environment
	  (TEE) for Android.  Trusty runs on the same processor as Linux but is
	  isolated from the rest of the system by both hardware and software.

	  This option enables the Linux kernel driver for Trusty, which
	  transfers data to/from Trusty.  This allows Linux userspace
	  applications to communicate with trusted applications.

	  If you build this as a module, it will be called trusty-core.

endmenu
```

## fs/crypto/Kconfig
```kconfig
config FS_ENCRYPTION
	bool "FS Encryption (Per-file encryption)"
	select CRYPTO
	select CRYPTO_AES
	select CRYPTO_CBC
	select CRYPTO_ECB
	select CRYPTO_XTS
	select CRYPTO_CTS
	select CRYPTO_SHA256
	select KEYS
	help
	  Enable encryption of files and directories.  This
	  feature is similar to ecryptfs, but it is more memory
	  efficient since it avoids caching the encrypted and
	  decrypted pages in the page cache.  Currently Ext4,
	  F2FS and UBIFS make use of this feature.

config FS_ENCRYPTION_HW_CRYPT
	tristate "Enable fscrypt to use inline crypto"
	default n
	depends on FS_ENCRYPTION && BLK_INLINE_ENCRYPTION
	help
	  Enables fscrypt to use inline crypto hardware if available.
```

## fs/incfs/Kconfig
```kconfig
config INCREMENTAL_FS
	tristate "Incremental file system support"
	depends on BLOCK
	select DECOMPRESS_LZ4
	select CRC32
	select CRYPTO
	select CRYPTO_RSA
	select CRYPTO_SHA256
	select X509_CERTIFICATE_PARSER
	select ASYMMETRIC_KEY_TYPE
	select ASYMMETRIC_PUBLIC_KEY_SUBTYPE
	help
	  Incremental FS is a read-only virtual file system that facilitates execution
	  of programs while their binaries are still being lazily downloaded over the
	  network, USB or pigeon post.

	  To compile this file system support as a module, choose M here: the
	  module will be called incrementalfs.

config INCFS_STATS
	bool "Gather statistical information on incremental file system"
	depends on INCREMENTAL_FS
	help
	  This option causes statistical information to be gathered and
	  exported through file:

		/proc/fs/incfs/stats

	  The gathering of statistics may add certain amount of overhead to
	  execution due to use of atomic instructions and on a
	  multi-CPU system these may be on cachelines that keep bouncing
	  between CPUs.  On the other hand, the stats are very useful for
	  debugging purposes.  Saying 'y' here is recommended.
```
