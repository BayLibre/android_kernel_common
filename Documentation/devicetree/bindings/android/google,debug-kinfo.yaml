## Documentation/devicetree/bindings/android/google,debug-kinfo.yaml
```yaml
# SPDX-License-Identifier: (GPL-2.0-only OR BSD-2-Clause)
%YAML 1.2
---
$id: "http://devicetree.org/schemas/android/google,debug-kinfo.ymal#"
$schema: "http://devicetree.org/meta-schemas/core.yaml#"

title: debug-kinfo for necessary kernel information stroed in memory

maintainers:
  — Song Xue <quic_songxue@quicinc.com>

description: |
  Debug-kinfo is used for adding device node to store necessary kernel information
  in reserved memory.

properties:
 compatible:
  const: google,debug-kinfo

 memory-region:
   maxItems: 1
   description:
      A phandle for a reserverd memory area that stores kernel debug information

required:
   - compatible
   - memory-region

examples:
  - |
        google,debug-kinfo {
                compatible = "google,debug-kinfo";
                memory-region = <&kinfo_mem>;
        };

        kinfo_mem: debug_kinfo_region {
                alloc-ranges = <0x0 0x00000000 0xffffffff 0xffffffff>;
                size = <0x0 0x1000>;
                no-map;
        };
```

## Documentation/devicetree/bindings/cpufreq/cpufreq-virtual.yaml
```yaml
# SPDX-License-Identifier: GPL-2.0-only OR BSD-2-Clause
%YAML 1.2
---
$id: http://devicetree.org/schemas/cpufreq/cpufreq-virtual.yaml#
$schema: http://devicetree.org/meta-schemas/core.yamll#

title: Virtual CPUFreq

maintainers:
  - David Dai <davidai@google.com>

description:
  Virtual CPUFreq is a virtualized driver in guest kernels that sends frequency
  selection of its vCPUs as a hint to the host through MMIO regions. The host
  uses the hint to schedule vCPU threads and select physical CPU frequency. It
  enables accurate Per-Entity Load Tracking for tasks running in the guest by
  querying host CPU frequency unless a virtualized FIE (ex. AMU) exists.

properties:
  compatible:
    const: virtual,cpufreq
  reg:
    maxItems: 1

required:
  - compatible
  - reg

additionalProperties: false

examples:
  - |
    cpus {
      #address-cells = <1>;
      #size-cells = <0>;

      cpu@0 {
        compatible = "arm,arm-v8";
        device_type = "cpu";
        reg = <0x0>;
        operating-points-v2 = <&opp_table0>;
      };

      cpu@1 {
        compatible = "arm,arm-v8";
        device_type = "cpu";
        reg = <0x0>;
        operating-points-v2 = <&opp_table1>;
      };
    };

    opp_table0: opp-table-0 {
      compatible = "operating-points-v2";

      opp1098000000 {
        opp-hz = /bits/ 64 <1098000000>;
        opp-level = <1>;
      };

      opp1197000000 {
        opp-hz = /bits/ 64 <1197000000>;
        opp-level = <2>;
      };
    };

    opp_table1: opp-table-1 {
      compatible = "operating-points-v2";

      opp1106000000 {
        opp-hz = /bits/ 64 <1106000000>;
        opp-level = <1>;
      };

      opp1277000000 {
        opp-hz = /bits/ 64 <1277000000>;
        opp-level = <2>;
      };
    };

    soc {
      #address-cells = <1>;
      #size-cells = <1>;

      cpufreq {
        reg = <0x1040000 0x10>;
        compatible = "virtual,cpufreq";
      };
    };
```

## Documentation/devicetree/bindings/exynos-usb-audio.txt
```
Exynos USB audio offloading with ABOX

The driver support for USB audio sync with ABOX.

Required properties:

  - compatible : "exynos-usb-audio-offloading"

Example:

exynos-usb-audio-offloading {
	compatible = "exynos-usb-audio-offloading";
};
```
