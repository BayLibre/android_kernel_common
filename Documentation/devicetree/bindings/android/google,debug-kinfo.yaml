## lib/Kconfig.ubsan
```kconfig
config ARCH_HAS_UBSAN_SANITIZE_ALL
	bool

config ARCH_WANTS_UBSAN_NO_NULL
	def_bool n

config UBSAN
	bool "Undefined behaviour sanity checker"
	help
	  This option enables undefined behaviour sanity checker
	  Compile-time instrumentation is used to detect various undefined
	  behaviours in runtime. Various types of checks may be enabled
	  via boot parameter ubsan_handle
	  (see: Documentation/dev-tools/ubsan.rst).

config UBSAN_SANITIZE_ALL
	bool "Enable instrumentation for the entire kernel"
	depends on UBSAN
	depends on ARCH_HAS_UBSAN_SANITIZE_ALL

	# We build with -Wno-maybe-uninitilzed, but we still want to
	# use -Wmaybe-uninitilized in allmodconfig builds.
	# So dependsy bellow used to disable this option in allmodconfig
	depends on !COMPILE_TEST
	default y
	help
	  This option activates instrumentation for the entire kernel.
	  If you don't enable this option, you have to explicitly specify
	  UBSAN_SANITIZE := y for the files/directories you want to check for UB.
	  Enabling this option will get kernel image size increased
	  significantly.

config UBSAN_ALIGNMENT
	bool "Enable checking of pointers alignment"
	depends on UBSAN
	default y if !HAVE_EFFICIENT_UNALIGNED_ACCESS
	help
	  This option enables detection of unaligned memory accesses.
	  Enabling this option on architectures that support unaligned
	  accesses may produce a lot of false positives.

config UBSAN_NULL
	bool "Enable checking of null pointers"
	depends on UBSAN
	default y if !ARCH_WANTS_UBSAN_NO_NULL
	help
	  This option enables detection of memory accesses via a
	  null pointer.

config UBSAN_BOUNDS
	bool "Perform array index bounds checking"
	depends on UBSAN
	default UBSAN
	help
	  This option enables detection of directly indexed out of bounds
	  array accesses, where the array size is known at compile time.
	  Note that this does not protect array overflows via bad calls
	  to the {str,mem}*cpy() family of functions (that is addressed
	  by CONFIG_FORTIFY_SOURCE).

config UBSAN_BOUNDS_ENFORCE
	bool "Trap on detected out of bounds access"
	depends on UBSAN
	depends on UBSAN_BOUNDS
	help
	  Building kernels with UBSAN features enabled tends to grow
	  the kernel size by over 5%, due to adding all the debugging
	  text on failure paths. To avoid this, Sanitizer instrumentation
	  can just issue a trap. This reduces the kernel size overhead but
	  turns all warnings into full thread-killing exceptions. This
	  option switches bounds sanitizer to the trap mode.


config UBSAN_MISC
	bool "Enable all other Undefined Behavior sanity checks"
	depends on UBSAN
	default UBSAN
	help
	  This option enables all sanity checks that don't have their
	  own config options. Disable it if you only want to have
	  individually selected checks.
```

## net/apf/Kconfig
```kconfig
# SPDX-License-Identifier: GPL-2.0-only
#
# Kconfig for the Android Packet Filter (APF) subsystem
#

config ANDROID_APF
	default y
	tristate "Android Packet Filter (APF) Subsystem"
	depends on NET
	help
	  This enables the Android Packet Filter (APF) subsystem, which provides
	  a generic netlink interface for userspace to configure network driver
	  and firmware implemented packet filtering capabilities.

	  If you are building a kernel for an Android device that uses APF,
	  say Y.
```

## sound/soc/spacemit/Kconfig
```kconfig
# SPDX-License-Identifier: GPL-2.0-only
menu "SpacemiT"
	depends on COMPILE_TEST || ARCH_SPACEMIT
	depends on HAVE_CLK

config SND_SOC_K1_I2S
	tristate "K1 I2S Device Driver"
	select SND_SOC_GENERIC_DMAENGINE_PCM
	depends on DMA_CMA
	help
	  Say Y or M if you want to add support for I2S driver for
	  K1 I2S controller. The device supports up to maximum of
	  2 channels each for play and record.

config SND_SOC_K3_RI2S
	tristate "K3 RI2S Device Driver"
	select SND_SOC_GENERIC_DMAENGINE_PCM
	help
	  Say Y or M to add support for the RI2S ASoC CPU DAI on the
	  SpacemiT K3 SoC. The RI2S controllers live in the RCPU audio
	  domain and feed audio through the ADMA cyclic DMA engine; on
	  the Muse Pico-ITX the ri2s3 instance carries DisplayPort audio
	  to the inno-dp-audio codec.

endmenu
```

## sound/soc/zhihe/Kconfig
```kconfig
# SPDX-License-Identifier: GPL-2.0-only

menu "ASoC support for ZHIHE"
	depends on ARCH_ZHIHE || COMPILE_TEST

config SND_SOC_ZHIHE_PCM
	tristate "Zhihe Dummy PCM And PCM DMA Support"
	depends on OF
	select SND_SOC_GENERIC_DMAENGINE_PCM
	help
	  Say Y or M to build the Zhihe dummy PCM DAI driver and the Zhihe
	  PCM DMA helper used by the Zhihe audio interface drivers.

config SND_SOC_ZHIHE_I2S
	tristate "Zhihe I2S Driver Support"
	depends on OF && (ARCH_ZHIHE || COMPILE_TEST)
	select SND_SOC_GENERIC_DMAENGINE_PCM
	select SND_SOC_ZHIHE_PCM
	help
	  Say Y or M if you want to add support for codecs or HDMI PCM
	  attached to the Zhihe A210 I2S interfaces.

endmenu
```
